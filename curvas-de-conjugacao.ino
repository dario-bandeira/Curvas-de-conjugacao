double a,b,c,d,e,f,g,h,i,j,x,y,pid,queda,dist,pas;
int linha, coluna;

double mapf(double x, double in_min, double in_max, double out_min, double out_max){
  return (x - in_min) * (out_max - out_min) / (in_max - in_min) + out_min;
}

double m[27][12] = {

//PID //Pás    //DIST --------------------------------------------------//
{0.00, 0.00,   0.00, 0.00, 0.00, 0.00, 0.00, 0.00, 0.00, 0.00, 0.00, 0.00}, // 0
{0.50, 0.00,   0.73, 0.71, 0.69, 0.66, 0.64, 0.62, 0.60, 0.59, 0.58, 0.56}, // 1
{1.00, 0.00,   1.47, 1.42, 1.38, 1.34, 1.30, 1.25, 1.22, 1.18, 1.15, 1.12}, // 2
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{10.0, 10.0,   10.0, 10.0, 9.76, 9.30, 8.99, 8.91, 8.73, 8.50, 8.29, 8.15}, // 25

{NULL, NULL,   10.0, 6.80, 4.40, 1.30,-1.07,-1.70,-3.44,-5.81,-8.18,-10.0}  // 26 Queda
//0    //1     //2   //3   //4   //5   //6   //7   //8   //9   //10  //11
};


void setup() {
  pinMode(A0, INPUT); //PID
  pinMode(A1, INPUT); //queda
  pinMode(7, OUTPUT); //pás
  pinMode(6, OUTPUT); //distribuidor
  Serial.begin(9600);
}

void loop() {

  pid = mapf(analogRead(A0),0,1023,0,10);
  queda = mapf(analogRead(A1),0,1023,10,-10);

  //localizando posição entre as linhas
  
  for (int i = 24; i >= 0; i--) {
    if (pid >= m[i][0]) {
      e = m[i][0];
      f = m[i+1][0];
      linha = i;
      break;
    }
  }

  //localizando posição entre as colunas

  for (int i = 10; i >= 2; i--) {
    if (queda <= m[26][i]) {
      g = m[26][i];
      h = m[26][i+1];
      coluna = i;
      break;
    }
  }
  
  a = m[linha][coluna];
  b = m[linha][coluna+1];
  c = m[linha+1][coluna];
  d = m[linha+1][coluna+1];

  x = (queda-h)/(g-h)*(a-b)+b;
  y = (queda-h)/(g-h)*(c-d)+d;
  dist = (pid-f)/(e-f)*(x-y)+y;

  pas = (pid - m[linha][0]) / (m[linha+1][0] - m[linha][0]) * (m[linha+1][1] - m[linha][1]) + m[linha][1];

  //mostrando na tela do computador
  Serial.print("PID: ");
  Serial.print(pid);
  Serial.print("  Queda: ");
  Serial.print(queda);
  Serial.print("  Pás: ");
  Serial.print(pas);
  Serial.print("  Distribuidor: ");
  Serial.println(dist);
  

  //saída no arduino
  analogWrite(7, mapf(pas,0,10,0,255));
  analogWrite(6, mapf(dist,0,10,0,255));

  delay(50);
}
